## components/cat_bridge/Kconfig
```kconfig
menu "CAT bridge (radio link)"

    config CAT_UART_NUM
        int "UART number used for CAT"
        range 1 2
        default 2
        help
            UART0 is reserved for the USB console / wired host link.

    config CAT_TX_PIN
        int "CAT TX GPIO (ESP32 -> radio)"
        default 32

    config CAT_RX_PIN
        int "CAT RX GPIO (radio -> ESP32)"
        default 34

    config CAT_BAUD_RATE
        int "CAT baud rate"
        default 9600

    choice CAT_FRAMING
        prompt "Framing of data received from the radio"
        default CAT_FRAMING_RAW
        help
            How the bytes coming from the radio are grouped before being
            forwarded to the host. It does not alter the bytes themselves.

        config CAT_FRAMING_RAW
            bool "Raw: group by idle gap (binary protocols, transparent)"
        config CAT_FRAMING_LINE
            bool "Text lines terminated by CR or LF"
        config CAT_FRAMING_TERMINATOR
            bool "Terminated by a specific byte (';' Kenwood/Elecraft/Yaesu, 0xFD Icom CI-V)"
    endchoice

    config CAT_TERMINATOR
        hex "Terminator byte"
        depends on CAT_FRAMING_TERMINATOR
        default 0x3B
        help
            0x3B is ';' (Kenwood, Elecraft, modern Yaesu). 0xFD is the Icom CI-V end byte.

    config CAT_IDLE_TIMEOUT_MS
        int "Idle gap that closes a raw frame (ms)"
        depends on CAT_FRAMING_RAW
        default 20

    config CAT_TX_INVERT
        bool "Invert CAT TX polarity"
        default y
        help
            The CAT transmit path is ESP32 TXD -> U10 optocoupler LED ->
            phototransistor -> Q4, and Q4 is saturated at rest because R27
            pulls its base to the isolated +5V. The result is that DE9 pin 8
            idles LOW, which a UART receiver reads as a permanent break.
            Inverting TXD in the peripheral puts the line back to idle HIGH.

            Keep this enabled for the stock board. Disable it only for a radio
            whose CAT input expects the inverted polarity, for instance a true
            RS-232 input where 0 V already reads as a mark.

    config CAT_RX_INVERT
        bool "Invert CAT RX polarity"
        default n
        help
            The receive path (D5, Q5 as a PNP, R28, U12) does not invert: a low
            at DE9 pin 3 produces a low at the GPIO. Validated on 2026-11-09 by
            injecting plain TTL text from a PL2303. Keep this disabled unless
            the radio drives the line inverted.

    config CAT_PTT_PIN
        int "PTT output GPIO"
        default 33

    config CAT_PTT_ACTIVE_LOW
        bool "PTT is active low (optocoupler LED to GND)"
        default y

    config CAT_COS_PIN
        int "COS / squelch input GPIO"
        default 39
        help
            GPIO39 (SENSOR_VN) is input-only and has no internal pull-up;
            the board provides an external one.

    config CAT_COS_ACTIVE_LOW
        bool "COS is active low"
        default y

endmenu
```

## components/host_link/Kconfig
```kconfig
menu "Host link (PC / phone control protocol)"

    config HOST_LINK_IDLE_FLUSH_MS
        int "Idle gap after which undelimited binary data is forwarded to the radio (ms)"
        default 30
        help
            Data from the host that contains no line delimiter is forwarded
            to the radio after this many milliseconds of silence, but only if
            it contains non-printable bytes (a binary CAT protocol). Printable
            text keeps waiting for CR/LF so that typing in a terminal works.
            0 disables the idle flush.

endmenu
```

## components/i2cdev/Kconfig
```kconfig
menu "I2C device access (i2cdev)"

config I2CDEV_TIMEOUT
    int "Tiempo maximo de una transaccion I2C, en milisegundos"
    default 1000
    range 100 5000
    help
        Se aplica tanto a la espera del mutex del dispositivo como a la
        transaccion en el bus.

endmenu
```

## components/serial_port/Kconfig
```kconfig
menu "Serial port task placement (advanced)"

    config SERIAL_PORT_DUAL_CORE
        bool "Enable dual-core task placement for UART receive tasks"
        default n
        help
            Pins the UART receive tasks (CAT to the radio, wired host link) to
            CPU1, isolating their jitter from BTstack's single-threaded run
            loop and SCO audio timing on CPU0.

            This option alone changes nothing: FREERTOS_NUMBER_OF_CORES /
            FREERTOS_UNICORE are system-level FreeRTOS settings that this app
            option cannot override. You must ALSO disable single-core mode
            yourself via Component config -> FreeRTOS. See the README section
            "Reparto de tareas entre nucleos" for the exact steps. If the
            firmware is still built in unicore mode, this option's effect is
            ignored at boot with a warning log; nothing breaks.

    config SERIAL_PORT_CAT_ON_CORE1
        bool "Pin the CAT (radio) UART task to core 1"
        depends on SERIAL_PORT_DUAL_CORE
        default y

    config SERIAL_PORT_HOST_SERIAL_ON_CORE1
        bool "Pin the wired host link (UART0) task to core 1"
        depends on SERIAL_PORT_DUAL_CORE
        default y

endmenu
```

## main/Kconfig.projbuild
```kconfig
menu "Radio Interface Configuration"

    config RADIO_BT_NAME
        string "Bluetooth device name"
        default "ESP32 Radio HF"
        help
            Name announced over Bluetooth (GAP local name) and used as the
            HFP Hands-Free service name in the SDP record.

    config RADIO_AG_ADDR
        string "Audio Gateway address for the test console"
        default "22:22:4F:BD:72:A0"
        help
            Bluetooth address (AA:BB:CC:DD:EE:FF) of the phone or PC that the
            serial test console connects to with the 'a' key. Only used for
            outgoing connections started from the console; incoming
            connections from any device are accepted regardless.

    config RADIO_SPP_CHANNEL
        int "RFCOMM channel of the SPP control service"
        range 2 30
        default 2
        help
            Channel 1 is used by HFP.

    config RADIO_SPP_SERVICE_NAME
        string "SPP service name"
        default "CAT Radio"

    choice RADIO_UART0_MODE
        prompt "UART0 (USB) mode"
        default RADIO_UART0_CONSOLE
        help
            UART0 is the USB serial port of the board (CH340G). It can be
            either the debug console or a wired control link that speaks the
            same protocol as the Bluetooth SPP service. Both cannot coexist
            on the same UART.

        config RADIO_UART0_CONSOLE
            bool "Console: logs, printf and the BTstack test console"
        config RADIO_UART0_CAT
            bool "CAT: wired host link with the control protocol (console muted)"
    endchoice

    config RADIO_HOST_SERIAL_BAUD
        int "Baud rate of the wired host link"
        depends on RADIO_UART0_CAT
        default 115200

    config RADIO_AUDIO_CAPTURE_ONLY
        bool "Diagnostic: capture-only audio (works around the swapped I2S data lines)"
        default n
        help
            TEMPORARY DIAGNOSTIC OPTION, for the bluesp32 board only.

            On that board the two I2S data nets reach the codec swapped: the
            codec's DACDAT (an input) hangs off the net that goes to IO35,
            which is input-only on the ESP32 and can never drive it, while the
            codec's ADCDAT (an output) hangs off the net that goes to IO26,
            which the driver uses as its output. The result is a constant tone
            instead of playback, and two drivers fighting over IO26.

            With this option enabled the I2S data input is moved to IO26, so
            the ESP32 reads the codec's real ADC output, and the data output is
            moved to IO23, which is unconnected on this board. That removes the
            contention and makes the capture direction (microphone towards the
            PC) work, so the diagnosis can be confirmed without reworking the
            board. Playback stays broken: that half cannot be fixed in
            software.

            Leave this off for a board whose R12/R14 wiring has been corrected.

endmenu
```
